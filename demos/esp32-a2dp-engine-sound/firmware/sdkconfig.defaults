## demos/esp32-a2dp-engine-sound/firmware/sdkconfig.defaults
```kconfig
CONFIG_IDF_TARGET="esp32"
CONFIG_ESPTOOLPY_FLASHSIZE_4MB=y
CONFIG_PARTITION_TABLE_SINGLE_APP_LARGE=y
CONFIG_ESP_DEFAULT_CPU_FREQ_MHZ_240=y
CONFIG_FREERTOS_HZ=1000
CONFIG_ESP_MAIN_TASK_STACK_SIZE=8192
CONFIG_FREERTOS_USE_TRACE_FACILITY=y
CONFIG_COMPILER_OPTIMIZATION_PERF=y
CONFIG_LOG_COLORS=n
CONFIG_BT_ENABLED=y
CONFIG_BTDM_CTRL_MODE_BR_EDR_ONLY=y
CONFIG_BT_BLUEDROID_ENABLED=y
CONFIG_BT_CLASSIC_ENABLED=y
CONFIG_BT_A2DP_ENABLE=y
CONFIG_BT_BTC_TASK_STACK_SIZE=6144
CONFIG_BT_BTU_TASK_STACK_SIZE=6144
CONFIG_BT_BLUEDROID_PINNED_TO_CORE_0=y
```

## demos/sticks3-ml307r-at/firmware/main/Kconfig.projbuild
```kconfig
menu "ML307R-DL Tiny bring-up"
config BRINGUP_TCP_HOST
    string "TCP probe host"
    default "example.com"
config BRINGUP_TCP_PORT
    int "TCP probe port"
    default 80
    range 1 65535
endmenu
```

## demos/sticks3-ml307r-at/firmware/sdkconfig.defaults
```kconfig
CONFIG_IDF_TARGET="esp32s3"
CONFIG_ESPTOOLPY_FLASHSIZE_8MB=y
CONFIG_ESPTOOLPY_FLASHSIZE="8MB"
CONFIG_ESP_MAIN_TASK_STACK_SIZE=8192
CONFIG_FREERTOS_CHECK_STACKOVERFLOW_CANARY=y
CONFIG_ESP_CONSOLE_SECONDARY_USB_SERIAL_JTAG=y
```

## projects/ev-engine-sound/firmware/main/Kconfig.projbuild
```kconfig
menu "EV engine sound"
config EV_BOARD_CONFIRMED
    bool "Enable the selected ESP32-S3 board pin profile"
    default n
    help
        Board sdkconfig defaults enable this only after EV_BOARD selects a
        matching board_config.h. Otherwise audio GPIOs stay untouched while
        synthesis, serial controls and diagnostics still run.
config EV_TIMEOUT_MS
    int "Control link timeout in milliseconds"
    range 500 10000
    default 2000
endmenu
```

## projects/m5stack-sticks3-gps-motobox/firmware/main/Kconfig.projbuild
```kconfig
menu "StickS3 GPS MotoBox Demo"

config DEMO_CELLULAR
    bool "Use ML307R-DL cellular uplink"
    default y

config DEMO_NTP_HOST
    string "Cellular UDP NTP server"
    default "ntp.aliyun.com"

config DEMO_WIFI_SSID
    string "Wi-Fi SSID"
    default ""

config DEMO_WIFI_PASSWORD
    string "Wi-Fi password"
    default ""

config DEMO_MQTT_URI
    string "MotoBox MQTT TLS URI"
    default "wss://emqx.daboluo.cc/mqtt"

config DEMO_MQTT_USERNAME
    string "Device MQTT username"
    default ""

config DEMO_MQTT_PASSWORD
    string "Device MQTT password"
    default ""

config DEMO_PUBLISH_INTERVAL_MS
    int "Telemetry interval (ms)"
    range 1000 60000
    default 5000

endmenu
```

## projects/m5stack-sticks3-gps-motobox/firmware/sdkconfig.defaults
```kconfig
CONFIG_IDF_TARGET="esp32s3"
CONFIG_ESPTOOLPY_FLASHSIZE_8MB=y
CONFIG_ESPTOOLPY_FLASHSIZE="8MB"
CONFIG_PARTITION_TABLE_CUSTOM=y
CONFIG_PARTITION_TABLE_CUSTOM_FILENAME="partitions.csv"
CONFIG_PARTITION_TABLE_FILENAME="partitions.csv"
CONFIG_ESP_DEFAULT_CPU_FREQ_MHZ_240=y
CONFIG_SPIRAM=y
CONFIG_SPIRAM_MODE_OCT=y
CONFIG_SPIRAM_SPEED_80M=y
CONFIG_SPIRAM_USE_MALLOC=y
CONFIG_SPIRAM_ALLOW_BSS_SEG_EXTERNAL_MEMORY=y
CONFIG_ESP_MAIN_TASK_STACK_SIZE=8192
CONFIG_FREERTOS_HZ=1000
CONFIG_FREERTOS_CHECK_STACKOVERFLOW_CANARY=y
CONFIG_COMPILER_OPTIMIZATION_PERF=y
CONFIG_LOG_DEFAULT_LEVEL_INFO=y
CONFIG_ESP_CONSOLE_UART_DEFAULT=y
CONFIG_ESP_CONSOLE_SECONDARY_USB_SERIAL_JTAG=y
CONFIG_MBEDTLS_CERTIFICATE_BUNDLE=y
CONFIG_MBEDTLS_CERTIFICATE_BUNDLE_DEFAULT_FULL=y
CONFIG_MBEDTLS_DEFAULT_MEM_ALLOC=y
CONFIG_LWIP_SNTP_MAX_SERVERS=1
CONFIG_LV_COLOR_DEPTH_16=y
CONFIG_LV_FONT_MONTSERRAT_12=y
CONFIG_LV_FONT_MONTSERRAT_14=y
CONFIG_LV_FONT_MONTSERRAT_20=y
CONFIG_LV_FONT_MONTSERRAT_28=y

CONFIG_DEMO_WIFI_SSID=""
CONFIG_DEMO_WIFI_PASSWORD=""
CONFIG_DEMO_MQTT_URI="wss://emqx.daboluo.cc/mqtt"
CONFIG_DEMO_MQTT_USERNAME=""
CONFIG_DEMO_MQTT_PASSWORD=""
CONFIG_DEMO_PUBLISH_INTERVAL_MS=5000
```
